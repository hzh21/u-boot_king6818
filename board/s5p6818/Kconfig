## board/s5p6818/Kconfig
```kconfig
choice
	prompt "Board select"


config TARGET_GEC6818
	bool "GEC6818"
	help
	  Support for gec6818 boards based on S5P6818 ported by xiaoY.

endchoice

config SYS_VENDOR
	default "s5p6818"

config SYS_CONFIG_NAME
	string "Board header file"
	help
	  This option should contain the base name of board header file.
	  The header file include/configs/<CONFIG_SYS_CONFIG_NAME>.h
	  should be included from include/config.h.

source "board/s5p6818/gec6818/Kconfig"
```
